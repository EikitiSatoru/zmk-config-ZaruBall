#include "ZaruBall.dtsi"

&kscan0 {
    col-gpios = 
        <&xiao_d 10 GPIO_ACTIVE_HIGH>,
        <&xiao_d 9 GPIO_ACTIVE_HIGH>,
        <&xiao_d 8 GPIO_ACTIVE_HIGH>,
        <&xiao_d 7 GPIO_ACTIVE_HIGH>,
        <&gpio0 9 GPIO_ACTIVE_HIGH>,
        <&gpio0 10 GPIO_ACTIVE_HIGH>,
        <&xiao_d 4 GPIO_ACTIVE_HIGH>;
};

&left_encoder {
    status = "okay";
};

/* ★左側ではトラックボールを無効化 */
&trackball {
    status = "disabled";
};

/* 念のため、リスナーも左では無効に固定しておく（もともと disabled だけど上書き） */
&trackball_listener {
    status = "disabled";
};
