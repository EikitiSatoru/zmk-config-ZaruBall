## boards/shields/ZaruBall/Kconfig.defconfig
```kconfig
if SHIELD_ZARUBALL_RIGHT
    # 右＝セントラル + トラックボール側

    config ZMK_KEYBOARD_NAME
        default "ZaruBall"

    config ZMK_SPLIT_ROLE_CENTRAL
        default y

    # USB をセントラル側だけ有効にしたい場合
    config ZMK_USB
        default y

    # セントラル専用のバッテリープロキシ
    config ZMK_SPLIT_BLE_CENTRAL_BATTERY_LEVEL_PROXY
        default y

    config ZMK_SPLIT_BLE_CENTRAL_BATTERY_LEVEL_FETCHING
        default y

    # トラックボール(PMW3610)を使うのでポインティング関係
    config ZMK_POINTING
        default y

    config PMW3610
        default y

    config INPUT
        default y

    # SPI も右だけ ON
    config SPI
        default y
endif


if SHIELD_ZARUBALL_LEFT
    # 左＝エンコーダだけ（トラックボールなし）

    config EC11
        default y

    config EC11_TRIGGER_GLOBAL_THREAD
        default y
endif


# 共通（左右どちらかなら分割キーボード）
if SHIELD_ZARUBALL_LEFT || SHIELD_ZARUBALL_RIGHT
    config ZMK_SPLIT
        default y
endif
```

## boards/shields/ZaruBall/Kconfig.shield
```kconfig
if SHIELD_ZARUBALL_RIGHT

# 右側＝セントラル & トラックボールあり

config ZMK_KEYBOARD_NAME
    default "ZaruBall"

config ZMK_SPLIT_ROLE_CENTRAL
    default y

# トラックボール(PMW3610)を使うのでポインティング関係を有効化
config ZMK_POINTING
    default y

config PMW3610
    default y

config INPUT
    default y

endif  # SHIELD_ZARUBALL_RIGHT


if SHIELD_ZARUBALL_LEFT

# 左側＝エンコーダのみ（トラックボールなし）

# EC11 エンコーダドライバを有効化
config EC11
    default y

config EC11_TRIGGER_GLOBAL_THREAD
    default y

endif  # SHIELD_ZARUBALL_LEFT


# 共通：左右どちらか片方でも使うなら SPLIT を有効化
if SHIELD_ZARUBALL_LEFT || SHIELD_ZARUBALL_RIGHT

config ZMK_SPLIT
    default y

endif
```

## config/west.yml
```yaml
manifest:
  remotes:
    - name: zmkfirmware
      url-base: https://github.com/zmkfirmware
    - name: inorichi
      url-base: https://github.com/inorichi
    #  - name: badjeff
    #   url-base: https://github.com/badjeff
    - name: caksoylar
      url-base: https://github.com/caksoylar
  projects:
    - name: zmk
      remote: zmkfirmware
      revision: v0.2.1
      import: app/west.yml
    - name: zmk-pmw3610-driver
      remote: inorichi
   #   remote: badjeff
      revision: main
    - name: zmk-rgbled-widget
      remote: caksoylar
      revision: 5f3efa6185bca7a3fa96d63e6d4d62eaf32dcec1
  self:
    path: config
```
